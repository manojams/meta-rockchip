## conf/machine/include/rock-pi-4c-plus.inc
```bitbake
# Add a common override for all Rock Pi 4 machines
MACHINEOVERRIDES =. "rock-pi-4c-plus:"

require conf/machine/include/rk3399.inc

MACHINE_EXTRA_RRECOMMENDS += "kernel-modules"
```

## conf/machine/rock-pi-4c-plus.conf
```bitbake
#@TYPE: Machine
#@NAME: Radxa ROCK 4C+
#@DESCRIPTION: Radxa ROCK 4C+ is a Raspberry Pi 4 Alternative based on Rockchip RK3399 Processor.

require conf/machine/include/rock-pi-4c-plus.inc

# kernel
PREFERRED_PROVIDER_virtual/kernel = "linux-next"
PREFERRED_VERSION_linux-next ?= "6.0-%"

# kernel defconfig
KBUILD_DEFCONFIG ?= "defconfig"

KERNEL_DEVICETREE = "rockchip/rk3399-rock-4c-plus.dtb"
UBOOT_MACHINE = "rock-pi-4c-rk3399_defconfig"
```
